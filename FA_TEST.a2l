/* generated by Asap2 Merger Version 4.2.22, 25th September 2006 */ ASAP2_VERSION 1 50
/begin PROJECT ProjectName "Project Comment Goes Here"
/begin HEADER "Header Comments go here" /end HEADER
/begin MODULE ModuleName "Module Comment Goes Here"
/begin MOD_PAR "MOD PAR Comment Goes Here" /end MOD_PAR
/begin MOD_COMMON "Mod Common Comment Here" BYTE_ORDER MSB_LAST /end MOD_COMMON
/begin CHARACTERISTIC tsa_enum_gears "" CURVE 0x802C49D1 Scalar_UBYTE_M 0 TMCM_6A45_CM_s_enum_Gears_M 0 255
 /begin AXIS_DESCR FIX_AXIS NO_INPUT_QUANTITY TMCM_6A45_CM_uint32_M 10 0 9 FIX_AXIS_PAR_DIST 0 1 10 /end AXIS_DESCR
/end CHARACTERISTIC
/begin MEASUREMENT rxd_flg_c3STG "CX31 Clutch 3 solenoid short to ground flg from BSW" UBYTE TMCM_6A45_CM_uint8_bit_M 0 0 0 1 ECU_ADDRESS 0xD000A0DE /end MEASUREMENT
/begin MEASUREMENT TMCM_6A45_B.tcd_enum_currentGear "" UBYTE TMCM_6A45_CM_s_enum_Gears_M 0 0 0 255 ECU_ADDRESS 0xD00104F4 /end MEASUREMENT
/begin MEASUREMENT spn2900_enum_engCrankEnb_SA_03 "" UBYTE TMCM_6A45_CM_uint8_M 0 0 0 3 ECU_ADDRESS 0xD00010F0 /end MEASUREMENT
/begin MEASUREMENT TMCM_6A45_B.tcd_enum_targetGear "" UBYTE TMCM_6A45_CM_s_enum_Gears_M 0 0 0 255 ECU_ADDRESS 0xD00104F7 /end MEASUREMENT
/begin RECORD_LAYOUT Scalar_UBYTE_M FNC_VALUES 1 UBYTE COLUMN_DIR DIRECT /end RECORD_LAYOUT
/begin COMPU_METHOD TMCM_6A45_CM_uint8_M "Q = V" RAT_FUNC "%3.0" "" COEFFS 0 1 0 0 0 1 /end COMPU_METHOD
/begin COMPU_METHOD TMCM_6A45_CM_uint32_M "Q = V" RAT_FUNC "%10.0" "" COEFFS 0 1 0 0 0 1 /end COMPU_METHOD
/begin COMPU_METHOD TMCM_6A45_CM_uint8_bit_M "Q = V" RAT_FUNC "%3.0" "bit" COEFFS 0 1 0 0 0 1 /end COMPU_METHOD
/begin COMPU_METHOD TMCM_6A45_CM_s_enum_Gears_M "Enumerated data type: s_enum_Gears" TAB_VERB "%0.6" "" COMPU_TAB_REF VTAB_FOR_TMCM_6A45_CM_s_enum_Gears_M /end COMPU_METHOD
/begin COMPU_VTAB VTAB_FOR_TMCM_6A45_CM_s_enum_Gears_M "Enumerated data type: s_enum_Gears" TAB_VERB 59 0 "s_enum_Gears_GEAR_NEUTRAL" 151 "s_enum_Gears_GEAR_NEUTRAL1" 152 "s_enum_Gears_GEAR_NEUTRAL2" 153 "s_enum_Gears_GEAR_NEUTRAL3" 154 "s_enum_Gears_GEAR_NEUTRAL4" 155 "s_enum_Gears_GEAR_NEUTRAL5" 156 "s_enum_Gears_GEAR_NEUTRAL6" 11 "s_enum_Gears_GEAR_1" 10 "s_enum_Gears_GEAR_1_OC" 8 "s_enum_Gears_GEAR_1LOW" 12 "s_enum_Gears_GEAR_1EB" 22 "s_enum_Gears_GEAR_2" 21 "s_enum_Gears_GEAR_2_OC" 9 "s_enum_Gears_GEAR_2LOW" 33 "s_enum_Gears_GEAR_3" 32 "s_enum_Gears_GEAR_3_OC" 44 "s_enum_Gears_GEAR_4" 43 "s_enum_Gears_GEAR_4_OC" 55 "s_enum_Gears_GEAR_5" 54 "s_enum_Gears_GEAR_5_OC" 66 "s_enum_Gears_GEAR_6" 65 "s_enum_Gears_GEAR_6_OC" 77 "s_enum_Gears_GEAR_7" 76 "s_enum_Gears_GEAR_7_OC" 88 "s_enum_Gears_GEAR_8" 87 "s_enum_Gears_GEAR_8_OC" 90 "s_enum_Gears_GEAR_9" 89 "s_enum_Gears_GEAR_9_OC" 160 "s_enum_Gears_GEAR_10" 161 "s_enum_Gears_GEAR_11" 162 "s_enum_Gears_GEAR_12" 163 "s_enum_Gears_GEAR_13" 164 "s_enum_Gears_GEAR_14" 165 "s_enum_Gears_GEAR_15" 166 "s_enum_Gears_GEAR_16" 99 "s_enum_Gears_GEAR_REVERSE" 98 "s_enum_Gears_GEAR_REVERSE_OC" 100 "s_enum_Gears_GEAR_REVERSELOW" 120 "s_enum_Gears_GEAR_REVERSE1" 119 "s_enum_Gears_GEAR_REVERSE1_OC" 130 "s_enum_Gears_GEAR_REVERSE2" 150 "s_enum_Gears_GEAR_REVERSE3" 170 "s_enum_Gears_GEAR_REVERSE4" 140 "s_enum_Gears_GEAR_PARK" 110 "s_enum_Gears_GEAR_NEUTRALP" 201 "s_enum_Gears_GEAR_COMB1" 202 "s_enum_Gears_GEAR_COMB2" 203 "s_enum_Gears_GEAR_COMB3" 204 "s_enum_Gears_GEAR_COMB4" 205 "s_enum_Gears_GEAR_COMB5" 206 "s_enum_Gears_GEAR_COMB6" 207 "s_enum_Gears_GEAR_COMB7" 208 "s_enum_Gears_GEAR_COMB8" 209 "s_enum_Gears_GEAR_COMB9" 210 "s_enum_Gears_GEAR_COMB10" 211 "s_enum_Gears_GEAR_COMB11" 212 "s_enum_Gears_GEAR_COMB12" 213 "s_enum_Gears_GEAR_COMB13" 255 "s_enum_Gears_GEAR_UNDEFINED" /end COMPU_VTAB
/begin GROUP S13623_TC_TG_M "TMCM_6A45/TMCM_6A45/TMCM_6A45/TRANSMISSION_COORDINATOR/TC/TC_TG"
 /begin REF_MEASUREMENT TMCM_6A45_B.tcd_enum_shiftIndex TMCM_6A45_B.tcd_enum_targetGear /end REF_MEASUREMENT
 /begin SUB_GROUP S13632_TC_GJAutoNeutral S13632_TC_GJDynamic S13632_TC_GJStable S13632_TC_GJStatic S13632_TC_GJT S13632_dynamicShiftCount S13632_multishiftDetermination S13632_sftIndxSprtn S13632_skipShiftJudgement S13632_spprtDwTypHld S13632_staticShiftCount /end SUB_GROUP
/end GROUP
/begin GROUP S13624_setCurrentGear_M "TMCM_6A45/TMCM_6A45/TMCM_6A45/TRANSMISSION_COORDINATOR/TC/TC_CG/setCurrentGear" /begin REF_CHARACTERISTIC tcc_flg_currGearUpdatedNeut tcc_tm_timeShiftGuard_ms /end REF_CHARACTERISTIC
 /begin REF_MEASUREMENT TMCM_6A45_B.tcd_enum_currentGear TMCM_6A45_B.tcd_flg_offGoingComplete TMCM_6A45_B.tcd_flg_onComingComplete /end REF_MEASUREMENT
 /begin SUB_GROUP S13634_EnumLookup /end SUB_GROUP
/end GROUP
/begin GROUP TMCM_6A45_M "TMCM_6A45" ROOT
 /begin REF_MEASUREMENT spn2538_CAN2_enum_transmMode3Ind_SA_03 spn2538_enum_transmMode3Ind_SA_03 spn2539_CAN2_enum_transmMode4Ind_SA_03 spn2539_enum_transmMode4Ind_SA_03 spn2900_CAN2_enum_engCrankEnb_SA_03 spn2900_enum_engCrankEnb_SA_03 spn2945_CAN2_enum_activeShftConsInd_SA_03 spn2945_enum_activeShftConsInd_SA_03 /end REF_MEASUREMENT
 /begin SUB_GROUP Root_TMCM_6A45 /end SUB_GROUP
/end GROUP
/begin GROUP TMCM_6A45_M "TMCM_6A45" ROOT
 /begin REF_MEASUREMENT rxd_flg_c1STB rxd_flg_c1STG rxd_flg_c2OPLOFF rxd_flg_c2OPLON rxd_flg_c2STB rxd_flg_c2STG rxd_flg_c3OPLOFF rxd_flg_c3OPLON /end REF_MEASUREMENT
 /begin SUB_GROUP Root_TMCM_6A45 /end SUB_GROUP
/end GROUP
/end MODULE
/end PROJECT
